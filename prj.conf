## CMakeLists.txt
```
# SPDX-License-Identifier: Apache-2.0

cmake_minimum_required(VERSION 3.13.1)

list(APPEND ZEPHYR_EXTRA_MODULES ${CMAKE_CURRENT_SOURCE_DIR}/modules/libmicroros)
list(APPEND BOARD_ROOT ${CMAKE_CURRENT_SOURCE_DIR}/../../boards/atk-dnesp32s3m-devboard)

# WiFi bootstrap 是超仓库里的共享 Zephyr module(micro-ROS 与 lfc-uc 共用)
if(EXISTS ${CMAKE_CURRENT_SOURCE_DIR}/../../modules/wifi_bootstrap)
    list(APPEND ZEPHYR_EXTRA_MODULES ${CMAKE_CURRENT_SOURCE_DIR}/../../modules/wifi_bootstrap)
endif()

# WiFi/agent 凭证等 CONFIG_* 直接取自超仓库根目录 ulf-uros.conf(单一来源,已
# gitignore),经共享宏按前缀提取到构建目录再叠加,同名配置覆盖 prj.conf 的占位值
# (OPTIONAL + COMMAND 判断:本模块单独 checkout 时无超仓库,退回 Kconfig 默认值)
include(${CMAKE_CURRENT_SOURCE_DIR}/../../cmake/ulf_uros_conf.cmake OPTIONAL)
if(COMMAND ulf_uros_extra_conf)
    ulf_uros_extra_conf(CONFIG_WIFI_BOOTSTRAP_ CONFIG_MICROROS_)
endif()

find_package(Zephyr REQUIRED HINTS $ENV{ZEPHYR_BASE})
project(microros_sample_app)

target_sources(app PRIVATE src/main.c)
```

## prj.conf
```kconfig
CONFIG_GPIO=y
CONFIG_MICROROS=y
CONFIG_CPP=y

CONFIG_MAIN_STACK_SIZE=25000
CONFIG_MAIN_THREAD_PRIORITY=3

CONFIG_NEWLIB_LIBC=y
CONFIG_NEWLIB_LIBC_NANO=n
CONFIG_PTHREAD_IPC=n

CONFIG_POSIX_API=y
CONFIG_POSIX_CLOCK=y

CONFIG_STDOUT_CONSOLE=y
CONFIG_LOG=y
CONFIG_SERIAL=y
CONFIG_UART_INTERRUPT_DRIVEN=y
CONFIG_UART_LINE_CTRL=y

# ===== micro-ROS UDP over WiFi =====
CONFIG_MICROROS_TRANSPORT_UDP=y
# agent IP/端口与 WiFi 凭证统一写在仓库根目录 ulf-uros.conf
# (均已 gitignore,由 CMakeLists 自动叠加),不要写在这里,防止误提交

CONFIG_WIFI=y
CONFIG_WIFI_BOOTSTRAP=y
CONFIG_NETWORKING=y
CONFIG_NET_L2_ETHERNET=y
CONFIG_NET_L2_WIFI_MGMT=y
CONFIG_NET_MGMT=y
CONFIG_NET_MGMT_EVENT=y
CONFIG_NET_MGMT_EVENT_INFO=y
CONFIG_NET_IPV4=y
CONFIG_NET_IPV6=n
CONFIG_NET_UDP=y
CONFIG_NET_SOCKETS=y
CONFIG_NET_DHCPV4=y
CONFIG_ESP32_WIFI_STA_AUTO_DHCPV4=y
CONFIG_DNS_RESOLVER=y
CONFIG_NET_PKT_RX_COUNT=16
CONFIG_NET_PKT_TX_COUNT=16
CONFIG_NET_BUF_RX_COUNT=32
CONFIG_NET_BUF_TX_COUNT=32
CONFIG_NET_MAX_CONTEXTS=10
CONFIG_HEAP_MEM_POOL_SIZE=65536
```

## boards/atk_dnesp32s3_esp32s3_procpu.overlay
```dts
/* 同 esp32c6_devkitc.overlay:wifi 外设默认 disabled,启用才会编入乐鑫 WiFi 驱动 */
&wifi {
	status = "okay";
};
```

## boards/esp32c6_devkitc.overlay
```dts
/* ESP32-C6 的 wifi 外设默认 disabled,启用它才会编入乐鑫 WiFi 驱动
 * (参照 zephyr/samples/net/wifi/shell/socs/esp32c6.overlay) */
&wifi {
	status = "okay";
};
```

## src/main.c
```c
#include <version.h>

#if ZEPHYR_VERSION_CODE >= ZEPHYR_VERSION(3,1,0)
#include <zephyr/kernel.h>
#include <zephyr/device.h>
#include <zephyr/devicetree.h>
#include <zephyr/drivers/gpio.h>
#include <zephyr/posix/time.h>
#else
#include <zephyr.h>
#include <device.h>
#include <devicetree.h>
#include <drivers/gpio.h>
#include <posix/time.h>
#endif

#include <rcl/rcl.h>
#include <rcl/error_handling.h>
#include <std_msgs/msg/int32.h>

#include <rclc/rclc.h>
#include <rclc/executor.h>

#include <rmw_microros/rmw_microros.h>
#include <microros_transports.h>

#if defined(CONFIG_WIFI_BOOTSTRAP)
#include <wifi_bootstrap.h>
#endif

#define RCCHECK(fn) { rcl_ret_t temp_rc = fn; if((temp_rc != RCL_RET_OK)){printf("Failed status on line %d: %d. Aborting.\n",__LINE__,(int)temp_rc);for(;;){};}}
#define RCSOFTCHECK(fn) { rcl_ret_t temp_rc = fn; if((temp_rc != RCL_RET_OK)){printf("Failed status on line %d: %d. Continuing.\n",__LINE__,(int)temp_rc);}}

rcl_publisher_t publisher;
std_msgs__msg__Int32 msg;

void timer_callback(rcl_timer_t * timer, int64_t last_call_time)
{
	RCLC_UNUSED(last_call_time);
	if (timer != NULL) {
		RCSOFTCHECK(rcl_publish(&publisher, &msg, NULL));
		msg.data++;
	}
}

int main(void)
{
#if defined(CONFIG_WIFI_BOOTSTRAP)
	wifi_bootstrap_connect();
#endif

	microros_transports_init();

	rcl_allocator_t allocator = rcl_get_default_allocator();
	rclc_support_t support;

	// create init_options
	RCCHECK(rclc_support_init(&support, 0, NULL, &allocator));

	// create node
	rcl_node_t node;
	RCCHECK(rclc_node_init_default(&node, "zephyr_int32_publisher", "", &support));

	// create publisher
	RCCHECK(rclc_publisher_init_default(
		&publisher,
		&node,
		ROSIDL_GET_MSG_TYPE_SUPPORT(std_msgs, msg, Int32),
		"zephyr_int32_publisher"));

	// create timer,
	rcl_timer_t timer;
	const unsigned int timer_timeout = 1000;
	RCCHECK(rclc_timer_init_default(
		&timer,
		&support,
		RCL_MS_TO_NS(timer_timeout),
		timer_callback));

	// create executor
	rclc_executor_t executor;
	RCCHECK(rclc_executor_init(&executor, &support.context, 1, &allocator));
	RCCHECK(rclc_executor_add_timer(&executor, &timer));

	msg.data = 0;

	while(1){
		rclc_executor_spin_some(&executor, 100);
		usleep(100000);
	}

	// free resources
	RCCHECK(rcl_publisher_fini(&publisher, &node))
	RCCHECK(rcl_node_fini(&node))
  return 0;    
}
```
